## drivers/misc/npcm-vdm/Kconfig
```kconfig
#
# NPCMX50 MISC drivers
#
menu "Nuvoton Miscellaneous optional drivers"

config NPCM_VDM
	tristate "support npcmx50 VDM on PCIe"
	depends on ARCH_NPCM
	default y
	help
	  Say Y here if you want ioctl npcmx50 VDM on PCIe.

	  To compile this driver as a module, choose M here: the
	  module will be called npcmx50_vdm.

endmenu
```

## drivers/soc/nuvoton/Kconfig
```kconfig
# SPDX-License-Identifier: GPL-2.0

menu "NUVOTON SoC drivers"

config NPCM_BPC
	tristate "NPCM BIOS Post Code support"
	depends on (ARCH_NPCM || COMPILE_TEST)
	help
	  Provides NPCM driver to control the BIOS Post Code
	  interface which allows the BMC to monitor and save
	  the data written by the host to an arbitrary I/O port,
	  the BPC is connected to the host thourgh LPC or eSPI bus.

config WPCM450_SOC
	tristate "Nuvoton WPCM450 SoC driver"
	default y if ARCH_WPCM450
	select SOC_BUS
	help
	  Say Y here to compile the SoC information driver for Nuvoton
	  WPCM450 SoCs.

	  This driver provides information such as the SoC model and
	  revision.

endmenu
```

## drivers/video/compression/Kconfig
```kconfig
#
# ECE configuration
#

config NPCM750_ECE
    tristate "Nuvoton ECE support"
    ---help---
      Enable Nuvoton Encoding and Compression Engine.
```

## drivers/video/vcd/Kconfig
```kconfig
config NPCM750_VCD
        tristate "Nuvoton npcm750 vcd support"
        help
          This enables support for npcm750 vcd.
```
