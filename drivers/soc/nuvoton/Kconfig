## drivers/soc/nuvoton/Kconfig
```kconfig
# SPDX-License-Identifier: GPL-2.0-only

if ARCH_NPCM || COMPILE_TEST

menu "NUVOTON SoC drivers"

config NPCM_MBOX_CERBERUS
	tristate "NPCM CERBERUS Mailbox"
	depends on ARCH_NPCM || COMPILE_TEST
	depends on MAILBOX
	help
	  An implementation of the NPCM mailbox controller.
	  It is used to send message between the Core processor and other 
	  processors on the BMC such as TIP and CP. 
	  Select Y here if you want to use NPCM mailbox controller.

config NPCM_SERIAL_PORT_CONTROL
	tristate "NPCM Serial Port Mode Control"
	depends on ARCH_NPCM || COMPILE_TEST
	help
	  Provides a driver to control the serial port switch that
	  enables the SoC to snoop and take over the serial interface.
	  Allow users to change the serial port mode via sysfs interface.

config NPCM_ESPI_MMBI
	tristate "NPCM MMBI Driver"
	depends on ARCH_NPCM || COMPILE_TEST
	help
	  Provides a driver to implement the mmbi protocol that
	  handle the data exchange between BMC and host over the
	  eSPI interface.

config NPCM_PCI_MMBI
	tristate "NPCM PCI Mailbox MMBI"
	depends on ARCH_NPCM || COMPILE_TEST
	help
	  Provides a driver to implement the mmbi protocol that
	  handle the data exchange between BMC and host over the
	  PCI Mailbox interface.

config NPCM_ESPI
	tristate "NPCM eSPI interrupt controller"
	depends on ARCH_NPCM || COMPILE_TEST
	select MFD_SYSCON
	select REGMAP_IRQ
	help
	  Provides the interrupt controller for the eSPI block, which owns
	  the status register the per channel drivers share and gives each
	  of them one interrupt of their own.  Required by the eSPI slave,
	  flash and virtual wire GPIO drivers.

config NPCM_ESPI_SLAVE
	tristate "NPCM SLAVE Driver"
	depends on ARCH_NPCM || COMPILE_TEST
	depends on NPCM_ESPI
	help
	  Provides a driver to implement the espi slave driver that
	  handle the espi events.

config MTD_NPCM_TIP_FIU
	tristate "Support NPCM TIP FIU"
	depends on ARCH_NPCM || COMPILE_TEST
	depends on MAILBOX
	depends on MTD
	help
	  This enables access to NOR device thourgh TIP in NPCM BMC's.

config NPCM_TIP_RNG
	tristate "Support NPCM TIP RNG"
	depends on ARCH_NPCM || COMPILE_TEST
	depends on MAILBOX
	depends on HW_RANDOM
	help
	  This enables access to HW RNG device thourgh TIP in NPCM BMC's.

endmenu

endif
```
