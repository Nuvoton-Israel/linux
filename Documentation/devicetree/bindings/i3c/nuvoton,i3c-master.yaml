## Documentation/devicetree/bindings/i3c/nuvoton,i3c-master.yaml
```yaml
# SPDX-License-Identifier: GPL-2.0-only OR BSD-2-Clause
%YAML 1.2
---
$id: http://devicetree.org/schemas/i3c/nuvoton,i3c-master.yaml#
$schema: http://devicetree.org/meta-schemas/core.yaml#

title: Nuvoton NPCM845 I3C master

maintainers:
  - Stanley Chu <yschu@nuvoton.com>
  - James Chiang <cpchiang1@nuvoton.com>

allOf:
  - $ref: "i3c.yaml#"

properties:
  compatible:
    const: nuvoton,npcm845-i3c

  reg:
    maxItems: 1

  interrupts:
    maxItems: 1

  clocks:
    items:
      - description: system clock
      - description: bus clock

  clock-names:
    items:
      - const: pclk
      - const: fast_clk

  resets:
    maxItems: 1

  i3c-pp-scl-hi-period-ns:
    maxItems: 1
    minimum: 40
    maximum: 160
    description: |
      If need to configure SCL with required duty cycle, specify the clock high/low period directly.
      i3c-pp-scl-hi-perios-ns specifies the high period ns of the SCL clock cycle in push pull mode
      When i3c-pp-scl-hi-period-ns and i3c-pp-scl-lo-period-ns are specified, the i3c pp frequency is
      decided by these two properties.

  i3c-pp-scl-lo-period-ns:
    maxItems: 1
    minimum: 40
    maximum: 310
    description: |
      The low period ns of the SCL clock cycle in push pull mode. i3c-pp-scl-lo-period-ns should not
      be less than i3c-pp-scl-hi-period-ns and the maximal value is i3c-pp-scl-hi-period-ns + 150.

  i3c-pp-sda-rd-skew:
    maxItems: 1
    minimum: 1
    maximum: 7
    description: |
      The number of MCLK clock periods to delay the SDA transition from the SCL clock edge at push
      pull operation when transfers i3c private read.

  i3c-pp-sda-wr-skew:
    maxItems: 1
    minimum: 1
    maximum: 7
    description: |
      The number of MCLK clock periods to delay the SDA transition from the SCL clock edge at push
      pull operation when transfers i3c private write.

  i3c-od-scl-hi-period-ns:
    maxItems: 1
    description: |
      The i3c open drain frequency is 1MHz by default.
      If need to use different frequency, specify the clock high/low period directly.
      i3c-od-scl-hi-perios-ns specifies the high period ns of the SCL clock cycle in open drain mode.
      When i3c-od-scl-hi-period-ns and i3c-od-scl-lo-period-ns are specified, the i3c od frequency is
      decided by these two properties.
      i3c-od-scl-hi-period-ns should be equal to i3c-pp-scl-hi-period-ns or i3c-od-scl-lo-period-ns.

  i3c-od-scl-lo-period-ns:
    maxItems: 1
    minimum: 200
    description: |
      The low period ns of the SCL clock cycle in open drain mode. i3c-od-scl-lo-period-ns should be
      multiple of i3c-pp-scl-hi-period-ns.

  enable-hj:
    type: boolean
    description: |
      Enable SLVSTART interrupt for receiving hot-join request.

  use-dma:
    type: boolean
    description: |
      Enable the i3c private transfers using DMA.

required:
  - compatible
  - reg
  - interrupts
  - clock-names
  - clocks

additionalProperties: true

examples:
  - |
    i3c-master@a0000000 {
        compatible = "nuvoton,npcm845-i3c";
        clocks = <&clk NPCM8XX_CLK_AHB>, <&clk NPCM8XX_CLK_RCP>;
        clock-names = "pclk", "fast_clk";
        interrupts = <GIC_SPI 224 IRQ_TYPE_LEVEL_HIGH>;
        reg = <0xfff10000 0x1000>;
        #address-cells = <3>;
        #size-cells = <0>;
    };
```

## Documentation/devicetree/bindings/soc/nuvoton/nuvoton,npcm845-composite-eat.yaml
```yaml
# SPDX-License-Identifier: (GPL-2.0-only OR BSD-2-Clause)
%YAML 1.2
---
$id: http://devicetree.org/schemas/soc/nuvoton/nuvoton,npcm845-composite-eat.yaml#
$schema: http://devicetree.org/meta-schemas/core.yaml#

title: Nuvoton NPCM845 Composite EAT mailbox client

maintainers:
  - Xiling Sun <xsun@microsoft.com>

description: |
  The NPCM845 Composite EAT client exchanges a CBOR request and a signed EAT
  response with TIP firmware through reserved shared memory. Scratchpad
  registers carry request metadata and mailbox doorbell 4 signals each side.

  ABI version 1 requires a 20-KiB reserved-memory region at physical address
  0x06201000. The first 4 KiB hold the request and the remaining 16 KiB hold
  the response.

properties:
  compatible:
    const: nuvoton,npcm845-composite-eat

  reg:
    maxItems: 1
    description: Scratchpad registers used by the BMC_DIRECT Composite EAT ABI.

  mboxes:
    maxItems: 1
    description: NPCM TIP mailbox physical channel 0, doorbell 4.

  mbox-names:
    const: composite-eat

  memory-region:
    maxItems: 1
    description: ABI v1 reserved-memory region at 0x06201000, size 0x5000.

required:
  - compatible
  - reg
  - mboxes
  - mbox-names
  - memory-region

additionalProperties: false

examples:
  - |
    / {
        compatible = "nuvoton,npcm845-evb", "nuvoton,npcm845";
        model = "Nuvoton NPCM845 Composite EAT example";
        #address-cells = <2>;
        #size-cells = <2>;

        reserved-memory {
            #address-cells = <2>;
            #size-cells = <2>;
            ranges;

            composite_eat_shm: composite-eat-shm@6201000 {
                reg = <0x0 0x06201000 0x0 0x00005000>;
                no-map;
            };
        };


        tip_mbox: mailbox@f080d000 {
            compatible = "nuvoton,npcm845-mbox";
            reg = <0x0 0xf080d000 0x0 0x1000>;
            #mbox-cells = <2>;
        };

        composite-eat@f0800e60 {
            compatible = "nuvoton,npcm845-composite-eat";
            reg = <0x0 0xf0800e60 0x0 0x20>;
            mboxes = <&tip_mbox 0 4>;
            mbox-names = "composite-eat";
            memory-region = <&composite_eat_shm>;
        };
      };
```

## drivers/usb/class/Kconfig
```kconfig
# SPDX-License-Identifier: GPL-2.0
#
# USB Class driver configuration
#
comment "USB Device Class drivers"

config USB_ACM
	tristate "USB Modem (CDC ACM) support"
	depends on TTY
	help
	  This driver supports USB modems and ISDN adapters which support the
	  Communication Device Class Abstract Control Model interface.
	  Please read <file:Documentation/usb/acm.rst> for details.

	  If your modem only reports "Cls=ff(vend.)" in the descriptors in
	  /sys/kernel/debug/usb/devices, then your modem will not work with this
	  driver.

	  To compile this driver as a module, choose M here: the
	  module will be called cdc-acm.

config USB_PRINTER
	tristate "USB Printer support"
	help
	  Say Y here if you want to connect a USB printer to your computer's
	  USB port.

	  To compile this driver as a module, choose M here: the
	  module will be called usblp.

config USB_WDM
	tristate "USB Wireless Device Management support"
	help
	  This driver supports the WMC Device Management functionality
	  of cell phones compliant to the CDC WMC specification. You can use
	  AT commands over this device.

	  To compile this driver as a module, choose M here: the
	  module will be called cdc-wdm.

config USB_TMC
	tristate "USB Test and Measurement Class support"
	help
	  Say Y here if you want to connect a USB device that follows
	  the USB.org specification for USB Test and Measurement devices
	  to your computer's USB port.

	  To compile this driver as a module, choose M here: the
	  module will be called usbtmc.

config USB_OBMF
	tristate "USB OBMF-ICP Class support"
	depends on USB
	help
	  USB class driver for OCP OBMF-ICP (Open Boot and Management
	  Framework - Interface Consolidation Protocol).  Presents OBMF
	  channels as virtual Linux subsystem devices (I2C adapters,
	  GPIO chips, SPI controllers, TTY ports, IPMI misc devices).

	  To compile this driver as a module, choose M here: the
	  module will be called obmf.

config USB_OBMF_I2C
	bool "OBMF I2C channel support"
	depends on USB_OBMF && I2C
	default y
	help
	  Enable OBMF-ICP I2C optimised channel (Type 04h).
	  Registers virtual I2C adapters via i2c_add_adapter().

config USB_OBMF_GPIO
	bool "OBMF GPIO channel support"
	depends on USB_OBMF && GPIOLIB
	default y
	help
	  Enable OBMF-ICP GPIO optimised channel (Type 05h, v0.9).
	  Registers virtual GPIO chips via gpiochip_add_data().

config USB_OBMF_SPI
	bool "OBMF SPI Controller channel support"
	depends on USB_OBMF && MTD
	default y
	help
	  Enable OBMF-ICP SPI Controller optimised channel (Type 08h, v0.9).
	  Handles device-initiated SPI NOR operations via Linux MTD framework.

config USB_OBMF_SERIAL
	bool "OBMF Serial channel support"
	depends on USB_OBMF && TTY
	default y
	help
	  Enable OBMF-ICP Serial optimised channel (Type 03h).
	  Creates /dev/ttyOBMF* devices via standalone tty_driver.

config USB_OBMF_IPMI
	bool "OBMF IPMI/SSIF channel support"
	depends on USB_OBMF
	default y
	help
	  Enable OBMF-ICP IPMI optimised channel (Type 06h).
	  Creates /dev/obmf-ipmi-* misc devices.
```
