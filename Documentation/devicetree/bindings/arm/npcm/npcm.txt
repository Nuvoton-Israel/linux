## Documentation/devicetree/bindings/arm/npcm/npcm.txt
```
NPCM Platforms Device Tree Bindings
-----------------------------------
NPCM750 SoC
Required root node properties:
	- compatible = "nuvoton,npcm750";

Optional root node properties:
	- nuvoton,npcm750-spswc : value of serial ports switch control register
```

## Documentation/devicetree/bindings/bmc/npcm7xx-mcu-flash.txt
```
Nuvoton NPCM7XX MCU FLASH interface

Nuvoton BMC NPCM7XX MCU FLASH is used for flashing MCU Firmware.

Required properties for mcu node
- compatible		: "nuvoton,npcm750-mcu-flash" for Poleg NPCM7XX.
			  "nuvoton,npcm845-mcu-flash" for Arbel NPCM8XX.
- dev-num		: specify the device node for MCU.
- mfsel-offset		: specify the offset of MFSEL.
- smb-offset		: specify the SMBSEL offset of MFSEL.
- mcu-gpios		: specify the GPIO number of SCLK pin.
		          specify the GPIO number of MOSI pin.
			  specify the GPIO number of MISO pin.
			  specify the GPIO number of RESET# pin.

Example:
mcu_flash {
    compatible = "nuvoton,npcm750-mcu-flash";
    status = "okay";
    #address-cells = <1>;
    #size-cells = <1>;
    dev-num = <0>;                              /* /dev/mcu0 */
    mfsel-offset = <0x260>;                     /* MFSEL1 */
    smb-offset = <1>;                           /* SMBSEL offset of MFSEL */
    mcu-gpios =  <&gpio0 29 GPIO_ACTIVE_HIGH>,	 /* GPIO29: SCLK */
		  <&gpio0 28 GPIO_ACTIVE_HIGH>,	 /* GPIO28: MOSI */
		  <&gpio2 12 GPIO_ACTIVE_HIGH>,	 /* GPIO76: MISO */
		  <&gpio2 13 GPIO_ACTIVE_LOW>;	 /* GPIO77: RESET# */
};
```

## Documentation/devicetree/bindings/bmc/npcm8xx-jtag-master.txt
```
Nuvoton NPCM8xx JTAG MASTER interface

Nuvoton BMC NPCM8xx JTAG Master is used for debugging host CPU or programming
CPLD device.

Required properties for jtag_master node
- compatible	: "nuvoton,npcm845-jtm" for Arbel NPCM8XX.
- reg 			: specifies physical base address and size of the registers.
- #address-cells: should be 1.
- #size-cells	: should be 0.
- interrupts	: contain the JTAG Master interrupt.
- clocks		: phandle of JTAG Master reference clock.
- clock-names	: Should be "clk_apb5".
- pinctrl-names : a pinctrl state named "default" must be defined.
- resets		: phandle to the reset control for this device.

Example:
jtm1: jtm@208000 {
	compatible = "nuvoton,npcm845-jtm";
	reg = <0x208000 0x1000>;
	pinctrl-names = "default";
	pinctrl-0 = <&jm1_pins>;
	#address-cells = <1>;
	#size-cells = <0>;
	interrupts = <GIC_SPI 188 IRQ_TYPE_LEVEL_HIGH>;
	clocks = <&clk NPCM8XX_CLK_APB5>;
	clock-names = "clk_apb5";
	resets = <&rstc NPCM8XX_RESET_IPSRST4 NPCM8XX_RESET_JTM1>;
};
```

## Documentation/devicetree/bindings/gpio/npcm7xx_mcu_gpi.txt
```
Nuvoton NPCM MCU I2C GPI Expender Emulator
--------------------------------------------

The Nuvoton Poleg BMC NPCM7XX MCU emulates an I2C expender with eight GPI signals.
MCU I2C 7-bit address 0x72,and One port 8 inputs.

Required properties:
- compatible	: "nuvoton,npcm7xx_mcu_gpi"; for Poleg NPCM7XX.
- reg		: I2C 7-bit address 0x72.


Example MCU I2C expander node:

&i2c13 {
	mcu_gpi@72 {
                compatible = "nuvoton,npcm7xx_mcu_gpi";
                reg = <0x72>;
                status = "okay";
                interrupts = <&gpio1 6 GPIO_ACTIVE_LOW>;
        };
};
```

## Documentation/devicetree/bindings/gpio/npcm7xx_sgpio.txt
```
Nuvoton  SGPIO controller Device Tree Bindings
--------------------------------------------

This SGPIO controller is for Nuvoton BMC
Nuvoton BMC includes two sgpio module.
Each module can supports up 64 pin input and 64 pin output.

Required properties:

- compatible : Should be one of  "nuvoton,npcm-sgpio"
- gpio-controller : Marks the device node as a GPIO controller
- interrupts : Interrupt specifier, see interrupt-controller/interrupts.txt
- ngpios : number of nin_gpios GPIO lines and nout_gpios GPIO line.
- clocks : A phandle to the APB3 clock for SGPM clock division
- bus-frequency : SGPM CLK frequency

The sgpio and interrupt properties are further described in their respective
bindings documentation:

- Documentation/devicetree/bindings/gpio/gpio.txt
- Documentation/devicetree/bindings/interrupt-controller/interrupts.txt

  Example:
	sgpio2: sgpio@102000 {
        	clocks = <&clk NPCM7XX_CLK_APB3>;
                compatible = "nuvoton,npcm7xx-sgpio";
                interrupts = <GIC_SPI 20 IRQ_TYPE_LEVEL_HIGH>;
                gpio-controller;
                pinctrl-names = "default";
                pinctrl-0 = <&iox2_pins>;
                reg = <0x102000 0x200>;
		bus-frequency = <16000000>;
        	nin_gpios = <8>;
        	nout_gpios = <8>;
        	gpio-line-names="s1","s2","s3","s4","s5","s6","s7","s8";
        	status = "okay";
                };
```

## Documentation/devicetree/bindings/gpio/nuvoton,sgpio.yaml
```yaml
# SPDX-License-Identifier: (GPL-2.0-only OR BSD-2-Clause)
%YAML 1.2
---
$id: http://devicetree.org/schemas/gpio/nuvoton,sgpio.yaml#
$schema: http://devicetree.org/meta-schemas/core.yaml#

title: Nuvoton SGPIO controller

maintainers:
  - Jim LIU <JJLIU0@nuvoton.com>

description: |
  This SGPIO controller is for NUVOTON NPCM7xx and NPCM8xx SoC.
  Nuvoton NPCM7xx SGPIO module is combine serial to parallel IC (HC595)
  and parallel to serial IC (HC165), and use APB3 clock to control it.
  This interface has 4 pins  (D_out , D_in, S_CLK, LDSH).
  NPCM7xx/NPCM8xx have two sgpio module each module can support up
  to 64 output pins,and up to 64 input pin, the pin is only for gpi or gpo.
  GPIO pins have sequential, First half is gpo and second half is gpi.
  GPIO pins can be programmed to support the following options
  - Support interrupt option for each input port and various interrupt
    sensitivity option (level-high, level-low, edge-high, edge-low)
  - ngpios is number of nuvoton,input-ngpios GPIO lines and nuvoton,output-ngpios GPIO lines.
    nuvoton,input-ngpios GPIO lines is only for gpi.
    nuvoton,output-ngpios GPIO lines is only for gpo.

properties:
  compatible:
    enum:
      - nuvoton,npcm750-sgpio
      - nuvoton,npcm845-sgpio

  reg:
    maxItems: 1

  gpio-controller: true

  '#gpio-cells':
    const: 2

  interrupts:
    maxItems: 1

  clocks:
    maxItems: 1

  nuvoton,input-ngpios:
    $ref: /schemas/types.yaml#/definitions/uint32
    description:
      The numbers of GPIO's exposed. GPIO lines is only for gpi.
    minimum: 0
    maximum: 64

  nuvoton,output-ngpios:
    $ref: /schemas/types.yaml#/definitions/uint32
    description:
      The numbers of GPIO's exposed. GPIO lines is only for gpo.
    minimum: 0
    maximum: 64

required:
  - compatible
  - reg
  - gpio-controller
  - '#gpio-cells'
  - interrupts
  - nuvoton,input-ngpios
  - nuvoton,output-ngpios
  - clocks

additionalProperties: false

examples:
  - |
    #include <dt-bindings/clock/nuvoton,npcm7xx-clock.h>
    #include <dt-bindings/interrupt-controller/arm-gic.h>
    gpio8: gpio@101000 {
        compatible = "nuvoton,npcm750-sgpio";
        reg = <0x101000 0x200>;
        clocks = <&clk NPCM7XX_CLK_APB3>;
        interrupts = <GIC_SPI 19 IRQ_TYPE_LEVEL_HIGH>;
        gpio-controller;
        #gpio-cells = <2>;
        nuvoton,input-ngpios = <64>;
        nuvoton,output-ngpios = <64>;
    };
```

## Documentation/devicetree/bindings/hwmon/npcm7xx-mcu-adc.txt
```
Nuvoton NPCM MCU I2C ADC Emulator device

The Nuvoton Poleg BMC NPCM7XX MCU supports 8 channels ADC with internal analog MUX.

Required properties:
- compatible	: "nuvoton,mcu71adc" for Poleg NPCM7XX.
- reg		: I2C 7-bit address 0x71.

Example MCU I2C ADC node:

&i2c13 {
	mcu_adc@71 {
		compatible = "nuvoton,mcu71adc";
		reg = <0x71>;
		status = "okay";
	};
};
```

## Documentation/devicetree/bindings/hwmon/nuvoton,nct7363.yaml
```yaml
# SPDX-License-Identifier: (GPL-2.0 OR BSD-2-Clause)
%YAML 1.2
---

$id: http://devicetree.org/schemas/hwmon/nuvoton,nct7363.yaml#
$schema: http://devicetree.org/meta-schemas/core.yaml#

title: Nuvoton NCT7363Y Hardware Monitoring IC

maintainers:
  - Ban Feng <kcfeng0@nuvoton.com>

description: |
  The NCT7363Y is a fan controller which provides up to 16 independent
  FAN input monitors, and up to 16 independent PWM outputs with SMBus interface.

  Datasheets: Available from Nuvoton upon request

properties:
  compatible:
    enum:
      - nuvoton,nct7363

  reg:
    maxItems: 1

  nuvoton,gpio0-mask:
    description: |
      configures GPIO0 Input Port register in bit[0:7], GPIO0 Output Port register in bit[8:15],
      GPIO0 Input/Output Configuration register in bit[16:23], and reserved in bit[24:31].
    $ref: /schemas/types.yaml#/definitions/uint32
    default: 0x00FF00FF;

  nuvoton,gpio1-mask:
    description: |
      configures GPIO1 Input Port register in bit[0:7], GPIO1 Output Port register in bit[8:15],
      GPIO1 Input/Output Configuration register in bit[16:23], and reserved in bit[24:31].
    $ref: /schemas/types.yaml#/definitions/uint32
    default: 0x00FF00FF;

  nuvoton,fscpxduty:
    description: |
      configures the default value of the duty-cycle control
    $ref: /schemas/types.yaml#/definitions/uint32
    default: 0x7F

  gpio-controller: true

  '#gpio-cells':
    const: 2

  interrupts:
    maxItems: 1

  "#pwm-cells":
    const: 2

patternProperties:
  "^fan-[0-9]+$":
    $ref: fan-common.yaml#
    unevaluatedProperties: false
    required:
      - pwms
      - tach-ch

required:
  - compatible
  - reg
  - gpio-controller
  - "#gpio-cells"
  - "#pwm-cells"

additionalProperties: false

examples:
  - |
    i2c {
        #address-cells = <1>;
        #size-cells = <0>;

        hwmon: hwmon@22 {
            compatible = "nuvoton,nct7363";
            reg = <0x22>;

            nuvoton,gpio0-mask = <0x00F700FF>;
            nuvoton,gpio1-mask = <0x00F700FF>;
            nuvoton,fscpxduty = <0xFF>;

            #pwm-cells = <2>;

            gpio-controller;
            #gpio-cells = <2>;
            gpio-line-names =
                "", "", "TEST_INPUT0", "TEST_OUTPUT0", "", "", "", "",
                "", "", "TEST_INPUT1", "TEST_OUTPUT1", "", "", "", "";
            interrupt-parent = <&gpio0>;
            interrupts = <1 IRQ_TYPE_EDGE_FALLING>;

            fan-0 {
                pwms = <&hwmon 0 50000>;
                tach-ch = /bits/ 8 <0x00>;
            };
            fan-1 {
                pwms = <&hwmon 1 50000>;
                tach-ch = /bits/ 8 <0x01>;
            };
        };
    };
```

## Documentation/devicetree/bindings/hwmon/nuvoton,nct736x.yaml
```yaml
# SPDX-License-Identifier: (GPL-2.0 OR BSD-2-Clause)
%YAML 1.2
---

$id: http://devicetree.org/schemas/hwmon/nuvoton,nct736x.yaml#
$schema: http://devicetree.org/meta-schemas/core.yaml#

title: Nuvoton NCT736X Hardware Monitoring IC

maintainers:
  - Ban Feng <kcfeng0@nuvoton.com>

description: |
  The NCT736X is a Fan controller which provides up to 16 independent
  FAN input monitors, and up to 16 independent PWM output with SMBus interface.
  Besides, NCT7363Y has a built-in watchdog timer which is used for
  conditionally generating a system reset output (INT#).

additionalProperties: false

properties:
  compatible:
    enum:
      - nuvoton,nct7362
      - nuvoton,nct7363

  reg:
    maxItems: 1

  nuvoton,pwm-mask:
    description: |
      each bit means PWMx enable/disable setting, where x = 0~15.
      0: disabled, 1: enabled
    $ref: /schemas/types.yaml#/definitions/uint32
    minimum: 0x0
    maximum: 0xFFFF
    default: 0x0

  nuvoton,fanin-mask:
    description: |
      each bit means FANINx monitoring enable/disable setting,
      where x = 0~15.
      0: disabled, 1: enabled
    $ref: /schemas/types.yaml#/definitions/uint32
    minimum: 0x0
    maximum: 0xFFFF
    default: 0x0

  nuvoton,wdt-timeout:
    description: |
      Watchdog Timer time configuration for NCT7363Y, as below
      0: 15 sec (default)
      1: 7.5 sec
      2: 3.75 sec
      3: 30 sec
    $ref: /schemas/types.yaml#/definitions/uint32
    enum: [0, 1, 2, 3]
    default: 0

required:
  - compatible
  - reg
  - nuvoton,pwm-mask
  - nuvoton,fanin-mask

examples:
  - |
    i2c {
        #address-cells = <1>;
        #size-cells = <0>;

        nct7363@22 {
            compatible = "nuvoton,nct7363";
            reg = <0x22>;

            nuvoton,pwm-mask = <0x003F>;
            nuvoton,fanin-mask = <0x003F>;
            nuvoton,wdt-timeout = <0x3>;
        };
    };
```

## Documentation/devicetree/bindings/i2c/i2c-mux-npcm.txt
```
Nuvoton NPCM7XX I2C bus mux switch

Required properties:
- compatible      	 : must be "nuvoton,i2c-mux-npcm"
- i2c-parent	  	 : phandle of the I2C bus that this multiplexer's master-side
					   port is connected to.
- syscon		  	 : phandle of the syscon node to access GCR register.
- nuvoton,i2c-number : I2C parent number.
- i2c_segment_number : List of I2C segment number that aligned with used I2C
					   bus mux pins.

* Standard pinctrl properties that specify the pin mux state for each child
  bus. See ../pinctrl/pinctrl-bindings.txt.

* Standard I2C mux properties. See i2c-mux.txt in this directory.

* I2C child bus nodes. See i2c-mux.txt in this directory.

Example:
		i2cmux0 {
			compatible = "i2c-mux-npcm";
			#address-cells = <1>;
			#size-cells = <0>;

			i2c-parent = <&i2c1>;
			syscon = <&gcr>;
			nuvoton,i2c-number = <1>;

			pinctrl-names = "default";
			pinctrl-0 = <&smb1_pins &smb1b_pins &smb1d_pins>;
			i2c_segment_number = <0>, <1>, <3>;
			status = "okay";

			i2c@2 {
				reg = <2>;
				#address-cells = <1>;
				#size-cells = <0>;
				status = "okay";

				eeprom {
					compatible = "atmel,24c04";
					reg = <0x50>;
					status = "okay";
				};
			};
		};
```

## Documentation/devicetree/bindings/i2c/i2c-npcm7xx.txt
```
Nuvoton NPCM7XX I2C bus

The NPCM750x includes sixteen I2C busses

Required properties:
- compatible      : "nuvoton,npcm750-i2c-bus" for Poleg NPCM750.
- reg             : Offset and length of the register set for the device.
- interrupts      : Contain the I2C interrupt with flags for falling edge.
- clocks          : phandle of I2C reference clock.

Optional:
- bus-frequency   : Contain the I2C bus frequency,
					the defualt I2C bus frequency is 100000.

Example:

i2c0: i2c-bus@f0080000 {
	reg = <0xf0080000 0x1000>;
	compatible = "nuvoton,npcm750-i2c-bus";
	clocks = <&clk NPCM7XX_CLK_APB2>;
	bus-frequency = <100000>;
	interrupts = <0 64 4>;
};
```

## Documentation/devicetree/bindings/i2c/i2c-slave-mqueue.txt
```
===============================================
Device Tree for I2C slave message queue backend
===============================================

Some protocols over I2C/SMBus are designed for bi-directional transferring
messages by using I2C Master Write protocol. This requires that both sides
of the communication have slave addresses.

This I2C slave mqueue (message queue) is used to receive and queue
messages from the remote i2c intelligent device; and it will add the target
slave address (with R/W# bit is always 0) into the message at the first byte.

Links
----
`Intelligent Platform Management Bus
Communications Protocol Specification
<https://www.intel.com/content/dam/www/public/us/en/documents/product-briefs/ipmp-spec-v1.0.pdf>`_

`Management Component Transport Protocol (MCTP)
SMBus/I2C Transport Binding Specification
<https://www.dmtf.org/sites/default/files/standards/documents/DSP0237_1.1.0.pdf>`_

Required Properties:
- compatible		: should be "i2c-slave-mqueue"
- reg			: slave address

Example:

i2c {
	slave_mqueue: i2c-slave-mqueue {
		compatible = "i2c-slave-mqueue";
		reg = <0x10>;
	};
};
```
