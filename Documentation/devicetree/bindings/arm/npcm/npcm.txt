## Documentation/devicetree/bindings/iio/adc/nuvoton,nct720x.yaml
```yaml
# SPDX-License-Identifier: (GPL-2.0 OR BSD-2-Clause)
%YAML 1.2
---
$id: http://devicetree.org/schemas/iio/adc/nuvoton,nct720x.yaml#
$schema: http://devicetree.org/meta-schemas/core.yaml#

title: Nuvoton nct7202 and similar ADCs

maintainers:
  - Eason Yang <yhyang2@nuvoton.com>

description: |
   Family of ADCs with i2c interface.

properties:
  compatible:
    enum:
      - nuvoton,nct7201
      - nuvoton,nct7202

  reg:
    maxItems: 1

required:
  - compatible
  - reg
  - read-vin-data-size : number of data bits per read vin (either 8 or 16)

additionalProperties: false

examples:
  - |
    i2c {
        #address-cells = <1>;
        #size-cells = <0>;

        nct7202@1d {
            compatible = "nuvoton,nct7202";
            reg = <0x1d>;
            read-vin-data-size = <8>;
        };
    };
```

## Documentation/devicetree/bindings/media/nuvoton,npcm-video.yaml
```yaml
# SPDX-License-Identifier: (GPL-2.0-only OR BSD-2-Clause)

%YAML 1.2
---
$id: http://devicetree.org/schemas/media/nuvoton,npcm-video.yaml#
$schema: http://devicetree.org/meta-schemas/core.yaml#

title: Nuvoton NPCM Video Capture/Encode Engine Device Tree Bindings

maintainers:
  - Joseph Liu <kwliu@nuvoton.com>
  - Marvin Lin <kflin@nuvoton.com>

description: |
  Video Capture/Differentiation Engine (VCD) and Encoding Compression Engine
  (ECE) present on Nuvoton NPCM SoCs.

properties:
  compatible:
    enum:
      - nuvoton,npcm750-video
      - nuvoton,npcm845-video

  reg:
    items:
      - description: VCD registers
      - description: ECE registers

  reg-names:
    items:
      - const: vcd
      - const: ece

  interrupts:
    maxItems: 1

  resets:
    items:
      - description: VCD reset control
      - description: ECE reset control

  reset-names:
    items:
      - const: vcd
      - const: ece

  nuvoton,syscon-gcr:
    $ref: /schemas/types.yaml#definitions/phandle
    description: Phandle to the Global Control Register DT node

  nuvoton,syscon-gfxi:
    $ref: /schemas/types.yaml#definitions/phandle
    description: Phandle to the Graphics Core Information DT node

  memory-region:
    description:
      CMA pool to use for buffers allocation instead of the default CMA pool.

required:
  - compatible
  - reg
  - reg-names
  - interrupts
  - resets
  - reset-names
  - nuvoton,syscon-gcr
  - nuvoton,syscon-gfxi

additionalProperties: false

examples:
  - |
    #include <dt-bindings/interrupt-controller/arm-gic.h>
    #include <dt-bindings/reset/nuvoton,npcm7xx-reset.h>

    video: video@f0810000 {
        compatible = "nuvoton,npcm750-video";
        reg = <0xf0810000 0x10000>,
              <0xf0820000 0x2000>;
        reg-names = "vcd", "ece";
        interrupts = <GIC_SPI 22 IRQ_TYPE_LEVEL_HIGH>;
        resets = <&rstc NPCM7XX_RESET_IPSRST2 NPCM7XX_RESET_VCD>,
                 <&rstc NPCM7XX_RESET_IPSRST2 NPCM7XX_RESET_ECE>;
        reset-names = "vcd", "ece";
        nuvoton,syscon-gcr = <&gcr>;
        nuvoton,syscon-gfxi = <&gfxi>;
    };
```

## Documentation/devicetree/bindings/misc/nuvoton,npcm750-mcu-flash.txt
```
Nuvoton NPCM MCU Flash Driver

Required properties:
- #address-cells : should be 1.
- #size-cells	 : should be 1.
- compatible      : "nuvoton,npcm750-mcu-flash" for Poleg NPCM7XX.

Example:

mcu_flash {
	compatible = "nuvoton,npcm750-mcu-flash";
	#address-cells = <1>;
	#size-cells = <1>;

	dev-num = <0>;    /* /dev/mcu0 */
	smb-offset = <6>; /* SMBSEL offset of MFSEL3 */

	mcu-gpios = <&gpio6 30 GPIO_ACTIVE_HIGH>,     /* GPIO222/PROG_CLK, Output */
				<&gpio6 31 GPIO_ACTIVE_HIGH>,     /* GPIO223/PROG_MOSI Output */
				<&gpio1 6 GPIO_ACTIVE_HIGH>,      /* GPIO38/PROG_MISO, Input  */
				<&gpio1 5 GPIO_ACTIVE_HIGH>;       /* GPIO37/RESET#, Output    */
	status = "okay";
};
```

## Documentation/devicetree/bindings/mmc/sdhci-npcm.txt
```
* NPCM SDHCI Controller

This file documents differences between the core properties in mmc.txt
and the properties used by the sdhci-npcm driver.

Required properties:
- compatible  : "nuvoton,npcm750-sdhci" for the NPCM7XX BMC.
				"nuvoton,npcm845-sdhci" for the NPCM8XX BMC.

Example:

		sdhci0: sdhci@f0842000 {
			compatible = "nuvoton,npcm750-sdhci";
			status = "disabled";
			reg = <0xf0842000 0x200>;
			interrupts = <GIC_SPI 26 IRQ_TYPE_LEVEL_HIGH>;
			clocks =  <&clk NPCM7XX_CLK_MMC>;
			clock-names = "clk_mmc";
			pinctrl-names = "default";
			pinctrl-0 = <&mmc8_pins
				     &mmc_pins>;
		};
```

## Documentation/devicetree/bindings/net/nuvoton,npcm7xx-emc.txt
```
Nuvoton NPCM7XX 10/100 Ethernet MAC Controller (EMC)

The NPCM750x provides two identical Ethernet MAC Controllers
for WAN/LAN applications

Required properties:
- compatible      : "nuvoton,npcm750-emc" for Poleg NPCM750.
- reg             : Offset and length of the register set for the device.
- interrupts      : Contain the emc interrupts with flags for falling edge.
					first interrupt dedicated to Txirq
					second interrupt dedicated to Rxirq
- clocks          : phandle of emc reference clock.
- device_type	  : Should be "network"

Example:

emc0: eth@f0825000 {
	device_type = "network";
	compatible = "nuvoton,npcm750-emc";
	reg = <0xf0825000 0x1000>;
	interrupts = <0 16 4>, <0 15 4>;
	clocks = <&clk NPCM7XX_CLK_EMC>;
};
```

## Documentation/devicetree/bindings/pci/npcm7xx-pcie.txt
```
Nuvoton NPCM7xx PCIe Root Complex

Required properties:
 - compatible : "nuvoton,npcm750-pcirc" for NPCM7XX BMC
 - reg : specifies physical base address and size of the register.
 - #address-cells : should be 3. see pci.txt
 - #size-cells : should be 2. see pci.txt
 - #interrupt-cells: should be 1. see pci.txt
 - device_type:	must be "pci"
 - interrupts : contain PCIe interrupt.
 - rst-rc-pci: specifies the gpio pins to be used for reset root complex.
 - rst-ep-pci: specifies the gpio pins to be used for reset end point.
 - bus-range: PCI bus numbers covered.
 - ranges: describes the translation of addresses for root ports and
			standard PCIe regions.

Example
	pci_rc: axi-pcie@e1000000 {
		#address-cells = <3>;
		#size-cells = <2>;
		#interrupt-cells = <1>;
		compatible = "nuvoton,npcm750-pcirc";
		reg = <0xe1000000 0x1000>;
		device_type = "pci";
		interrupts = <GIC_SPI 127 IRQ_TYPE_LEVEL_HIGH>;
		bus-range = <0x00 0xff>;
		rst-rc-pci = <&gpio0 29 1>;
		rst-ep-pci = <&gpio0 29 1>;
		ranges = <0x02000000 0 0xea000000
			0xea000000 0 0x02000000>;
	};
```

## Documentation/devicetree/bindings/rng/nuvoton,npcm7xx-rng.txt
```
NPCM7XX SoC random number generator.

Required properties:
- compatible  : "nuvoton,npcm750-rng" for Poleg NPCM750
- reg         : Offset and length of the registers set for the rng device.

Optional:
- clocks          : phandle of rng reference clock.

Example:

rng: rng@f000b000 {
	compatible = "nuvoton,npcm750-rng";
	reg = <0xf000b000 0x1000>;
	clocks = <&clk NPCM7XX_CLK_APB1>;
};
```

## Documentation/devicetree/bindings/soc/nuvoton/nuvoton,vwgpio.yaml
```yaml
# SPDX-License-Identifier: (GPL-2.0-only OR BSD-2-Clause)
%YAML 1.2
---
$id: http://devicetree.org/schemas/soc/nuvoton/nuvoton,vwgpio.yaml#
$schema: http://devicetree.org/meta-schemas/core.yaml#

title: Nuvoton ESPI VWGPIO controller

maintainers:
  - Tomer Maimon <Tomer.Maimon@nuvoton.com>
  - Ban Feng <kcfeng0@nuvoton.com>
  - Stanley Chu <yschu@nuvoton.com>

description:
  The NPCM8xx supports the Intel Enhanced Serial Peripheral Interface (eSPI) Revision 1.0.

properties:
  compatible:
    items:
      - enum:
          - nuvoton,npcm845-espi
      - const: simple-mfd
      - const: syscon

  reg:
    maxItems: 1

patternProperties:
  "^vw_gpio@[0-9a-f]+$":
    type: object
    additionalProperties: false

    description: |
      This VWGPIO controller is for NUVOTON NPCM8xx SoC, NPCM8xx has one
      vwgpio module can support up to 64 output pins (VWGPSM0-15), and
      up to 64 input pins (VWGPMS0-15), in this order.
      VWGPIO pins can be programmed to support interrupt option for each
      input port and various interrupt sensitivity option (level-high,
      level-low, edge-high, edge-low)

    properties:
      compatible:
        items:
          - enum:
              - nuvoton,npcm845-espi-vwgpio

      interrupts:
        maxItems: 1

      gpio-controller: true

      '#gpio-cells':
        const: 2

      nuvoton,gpio-control-map:
        $ref: /schemas/types.yaml#/definitions/uint32
        enum: [0, 1, 2, 3]
        default: 0
        description: |
          Controls the mapping of all the GPIO Virtual Wires (VWGPSM0-15,
          VWGPMS0-15, in this order) to indices as follows
            0: 80-111 (50h-6Fh) (default)
            1: 128-159 (80h-9Fh)
            2: 160-191 (A0h-BFh)
            3: 192-223 (C0h-DFh)

      nuvoton,control-interrupt-map:
        $ref: /schemas/types.yaml#/definitions/uint32
        enum: [0, 1, 2, 3]
        default: 0
        description: |
          Controls the mapping of interrupts 15-0 (in this order) originating
          from the device modules to the reported IRQ lines of the Host.
            0: 15-0 (default)
            1: 31-16
            2: 47-32
            3: 63-48

      nuvoton,index-en-map:
        $ref: /schemas/types.yaml#/definitions/uint32
        minimum: 0x0
        maximum: 0xFFFFFFFF
        default: 0x0
        description: |
          Defines the index of the Virtual Wire group (VWGPMS15-0, VWGPSM15-0,
          in this order)

      nuvoton,vwgpms-wire-map:
        $ref: /schemas/types.yaml#/definitions/uint64
        minimum: 0x0
        maximum: 0xFFFFFFFFFFFFFFFF
        default: 0x0
        description: |
          Each bit indicates the state of a Virtual Wire of the group (VWGPMS15-0)

      nuvoton,vwgpsm-wire-map:
        $ref: /schemas/types.yaml#/definitions/uint64
        minimum: 0x0
        maximum: 0xFFFFFFFFFFFFFFFF
        default: 0xFFFFFFFFFFFFFFFF
        description: |
          Each bit indicates the state of a Virtual Wire of the group (VWGPSM15-0)

    required:
      - compatible
      - interrupts
      - gpio-controller
      - '#gpio-cells'
      - nuvoton,gpio-control-map
      - nuvoton,control-interrupt-map
      - nuvoton,index-en-map
      - nuvoton,vwgpms-wire-map
      - nuvoton,vwgpsm-wire-map

required:
  - compatible
  - reg

additionalProperties:
  type: object

examples:
  - |
    #include <dt-bindings/interrupt-controller/arm-gic.h>

    espi: espi@9f000 {
        compatible = "nuvoton,npcm845-espi", "simple-mfd", "syscon";
        reg = <0x9F000 0x1000>;

        vw_gpio: vw_gpio {
            compatible = "nuvoton,npcm845-espi-vwgpio";
            interrupts = <GIC_SPI 18 IRQ_TYPE_LEVEL_HIGH>;
            gpio-controller;
            #gpio-cells = <2>;
            nuvoton,gpio-control-map = <1>;
            nuvoton,control-interrupt-map = <0>;
            nuvoton,index-en-map = <0x80000000>;
            nuvoton,vwgpms-wire-map = <0x80000000 0x0>;
        };
    };
```

## Documentation/devicetree/bindings/usb/npcm-udc.txt
```
Nuvoton NPCM USB Device controller.

This DT-binding describe Nuvoton NPCM USB Device controller (UDC) device node.
The UDC is based on Chipidea Subsystem Device Controller IP.

Required properties:
- compatible	  : "nuvoton,npcm750-udc" for Poleg NPCM7XX.
		    "nuvoton,npcm845-udc" for Arbel NPCM8XX.
- reg             : Offset and length of the register set for the device,
		    Offset and length of the DTD buffer.
- interrupts      : Contain the UDC interrupt.
- clocks          : phandle of UDC reference clock.
- clock-names     : Should be "clk_usb_bridge".

Note: Each npcm-udc which should have an alias correctly numbered
in "aliases" node.

e.g.
aliases {
	udc1 = &udc1;
};

Example:
		udc0:udc@f0830000 {
			compatible = "nuvoton,npcm750-udc";
			reg = <0xf0830000 0x1000
			       0xfffd0000 0x800>;
			interrupts = <GIC_SPI 51 IRQ_TYPE_LEVEL_HIGH>;
			status = "disabled";
			clocks = <&clk NPCM7XX_CLK_SU>;
			clock-names = "clk_usb_bridge";
		};
```

## drivers/crypto/npcm/Kconfig
```kconfig
config CRYPTO_DEV_NPCM_AES
	tristate "NPCM AES acceleration support"
	depends on CRYPTO_DEV_NPCM
	default y
	select CRYPTO_AES
	help
	  Support for Nuvoton BMC NPCM AES HW.
```

## drivers/crypto/npcmX50/Kconfig
```kconfig
config CRYPTO_DEV_NPCM750_SHA
	tristate "NPCM750 SHA acceleration support"
	depends on CRYPTO_DEV_NPCMX50
	default y	
	select CRYPTO_SHA1
	select CRYPTO_SHA256
	help
	  Support for BMC Nuvoton NPCM750 SHA HW.

config CRYPTO_DEV_NPCM750_AES
	tristate "NPCM750 AES acceleration support"
	depends on CRYPTO_DEV_NPCMX50
	default y
	select CRYPTO_AES
	help
	  Support for Nuvoton BMC NPCM750 AES HW.
```

## drivers/dma/nuvoton/Kconfig
```kconfig
# SPDX-License-Identifier: GPL-2.0-only

config NPCM_GDMA
	tristate "Nuvoton NPCM GDMA support"
	depends on ARCH_NPCM || COMPILE_TEST
	select DMA_ENGINE
	help
	  Enable support for GDMA controller on Nuvoton NPCM SoCs.
```

## drivers/media/platform/nuvoton/Kconfig
```kconfig
# SPDX-License-Identifier: GPL-2.0-only

comment "Nuvoton media platform drivers"

config VIDEO_NPCM_VCD_ECE
	tristate "Nuvoton NPCM Video Capture/Encode Engine driver"
	depends on V4L_PLATFORM_DRIVERS
	depends on VIDEO_DEV
	select VIDEOBUF2_DMA_CONTIG
	help
	  Support for the Video Capture/Differentiation Engine (VCD) and
	  Encoding Compression Engine (ECE) present on Nuvoton NPCM SoCs.

config VIDEO_NPCM_RES_CHANGE_INT
	tristate "Support for resolution change interrupt"
	depends on VIDEO_NPCM_VCD_ECE
	default n
	help
	  Support for resolution change interrupt. Driver will send
	  V4L2_EVENT_SRC_CH_RESOLUTION event when resolution has changed.
```
